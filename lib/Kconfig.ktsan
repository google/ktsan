## lib/Kconfig.ktsan
```kconfig
config HAVE_ARCH_KTSAN
	bool

if HAVE_ARCH_KTSAN

config KTSAN
	bool "ThreadSanitizer: dynamic data race error detector"
	default n

endif
```

## lib/Kconfig.tsan
```kconfig
config HAVE_ARCH_TSAN
	bool

if HAVE_ARCH_TSAN

config TSAN
	bool "ThreadSanitizer: dynamic data race error detector"
	default n

endif
```
